## conf/machine/orangepi-cm4.conf
```bitbake
#@TYPE: Machine
#@NAME: Orange Pi CM4
#@DESCRIPTION: 5th generation SBC designed by Kunlong Co.,Limited.
#http://www.orangepi.org/html/hardWare/computerAndMicrocontrollers/details/Orange-Pi-5-plus-32GB.html

require conf/machine/include/rk3566.inc

KERNEL_DEVICETREE = "rockchip/rk3566-orangepi-cm4.dtb"
MACHINE_EXTRA_RRECOMMENDS += "kernel-modules"

UBOOT_MACHINE = "orangepi-cm4-rk3566_defconfig"
```
